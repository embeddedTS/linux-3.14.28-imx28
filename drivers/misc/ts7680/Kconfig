## drivers/misc/ts7680/Kconfig
```kconfig
#
# Driver for the embeddedTS M0 uC on the TS-7680 board
#
menu "embeddedTS TS-7680 M0 Driver"
config TS_M0
	tristate "TS-7680 M0 Driver"
	depends on SOC_IMX28 && I2C
	help
	  This option enables the driver for the M0 uC on the
	  embeddedTS TS-7680 board.

endmenu
```
